## applications/Kconfig
```kconfig
menu "Application Config"

	config APP_USING_CPUUSAGE
			bool "use cpu usage calculation"
			default y

endmenu
```

## board/Kconfig
```kconfig
menu "Hardware Drivers Config"

menu "Select Chip"
	config SOC_STM32F407ZG
		bool "STM32F407ZG"
		select SOC_SERIES_STM32F4
		default n
	config SOC_STM32F411CE
		bool "STM32F411CE"
		select SOC_SERIES_STM32F4
		default y
endmenu

menu "Onboard Peripheral Drivers"

	config BSP_USING_LED
		bool "Enable led driver"
		default y
		
endmenu

menu "On-chip Peripheral Drivers"

    config BSP_USING_GPIO
        bool "Enable GPIO"
        select RT_USING_PIN
        default y

	menuconfig BSP_USING_TIM	
		bool "Enable hardware timer"
		default y
		select RT_USING_HWTIMER
		if BSP_USING_TIM
			config BSP_USING_TIM1
				bool "Enable timer 1"
				default n
			config BSP_USING_TIM2
				bool "Enable timer 2"
				default n
			config BSP_USING_TIM3
				bool "Enable timer 3"
				default n
			config BSP_USING_TIM4
				bool "Enable timer 4"
				default n
		endif
		
	menuconfig BSP_USING_I2C1
		bool "Enable I2C1"
		default n
		select RT_USING_I2C	
		if BSP_USING_I2C1
			config BSP_USING_I2C_BITOPS
			bool "Use GPIO to simulate I2C"
			default y
			select RT_USING_I2C_BITOPS
			
			if BSP_USING_I2C_BITOPS
				config BSP_I2C1_SDA_PIN
					int "simulate I2C1 SDA"
					default 25
				config BSP_I2C1_SCL_PIN
					int "simulate I2C1 SCL"
					default 24
			endif
		endif
	
	
    menuconfig BSP_USING_UART
        bool "Enable UART"
        default y
        select RT_USING_SERIAL
        if BSP_USING_UART
            config BSP_USING_UART1
                bool "Enable UART1"
                default n

            config BSP_UART1_RX_USING_DMA
                bool "Enable UART1 RX DMA"
                depends on BSP_USING_UART1 && RT_SERIAL_USING_DMA
                default n
				
			config BSP_USING_UART2
				bool "Enable UART2"
				default y
        endif

    menuconfig BSP_USING_SPI
        bool "Enable SPI BUS"
        default n
        select RT_USING_SPI
        if BSP_USING_SPI
            config BSP_USING_SPI1
                bool "Enable SPI1 BUS"
                default n

            config BSP_SPI1_TX_USING_DMA
                bool "Enable SPI1 TX DMA"
                depends on BSP_USING_SPI1
                default n
                
            config BSP_SPI1_RX_USING_DMA
                bool "Enable SPI1 RX DMA"
                depends on BSP_USING_SPI1
                select BSP_SPI1_TX_USING_DMA
                default n
        endif

    

endmenu

menu "Board extended module Drivers"

endmenu
 
endmenu
```
